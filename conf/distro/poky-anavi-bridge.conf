## conf/distro/poky-anavi-bridge.conf
```bitbake
require conf/distro/poky.conf

DISTRO = "poky-anavi-bridge"
DISTRO_NAME = "ANAVI Bridge"

# Switch to systemd
DISTRO_FEATURES_append = " systemd"
VIRTUAL-RUNTIME_init_manager = "systemd"
DISTRO_FEATURES_BACKFILL_CONSIDERED = "sysvinit"
VIRTUAL-RUNTIME_initscripts = ""
```

## conf/layer.conf
```bitbake
# We have a conf and classes directory, add to BBPATH
BBPATH .= ":${LAYERDIR}"

# We have recipes-* directories, add to BBFILES
BBFILES += "${LAYERDIR}/recipes-*/*/*.bb \
            ${LAYERDIR}/recipes-*/*/*.bbappend"

BBFILE_COLLECTIONS += "meta-homebridge"
BBFILE_PATTERN_meta-homebridge = "^${LAYERDIR}/"
BBFILE_PRIORITY_meta-homebridge = "6"

LAYERDEPENDS_meta-homebridge = "core"
LAYERSERIES_COMPAT_meta-homebridge = "warrior zeus"
```
